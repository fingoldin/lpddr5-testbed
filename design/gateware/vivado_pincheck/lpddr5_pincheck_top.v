// GENERATED by scripts/gen_gateware.py.  Pin-plan check of the LPDDR5 test card: NOT a memory controller.
// It instantiates the real I/O structure on the real pins of ../lpddr5_testbed_zcu104.xdc so that Vivado can
// say whether the plan is legal (synthesis, place, route, DRC, bitstream):
//   command  bank 65   CMD_NATIVE = 1: native TX_BITSLICE, PLL VCO 800 MHz x2 = 1.6 Gb/s (CK = 800 MHz);
//                              CMD_NATIVE = 0: component-mode OSERDESE3 at CMD_COMP_HS MHz x2
//   write    bank 64   OSERDESE3 -> ODELAYE3 (TIME, per-bit value) -> OBUFT; WCK OSERDESE3 -> ODELAYE3 -> OBUFDS
//   read     bank 66   RX_SLVS = 0: IBUFDS_DPHY (MIPI_DPHY_DCI on the instance, DIFF_TERM FALSE, LP off)
//                              RX_SLVS = 1: IBUFDS (SLVS_400_18 from the override XDC)
//                              RX_SLVS = 2: IBUFDS_DPHY with IOSTANDARD "DEFAULT" on the instance (the standard from the XDC)
//                              RX_SLVS = 3: as 2, with the SLVS_400_18 override XDC (negative test)
//                              -> IDELAYE3 (TIME, per-bit value) -> ISERDESE3; RDQS the same way (RDQS_AS_CLOCK = 0),
//                              or RDQS as the capture clock through a BUFGCE: taken behind its IDELAYE3
//                              (RDQS_AS_CLOCK = 1, negative test) or straight from the receiver (RDQS_AS_CLOCK = 2)
//   reset_n  LVCMOS12, static, the only output in the read bank
// Clock: the ZCU104 300 MHz system clock (CLK_300, AH18 / AH17, bank 64), see pincheck_board.xdc.
`timescale 1ps/1ps

module pincheck_cmd_nibble #(parameter [6:0] TXMASK = 7'd0) (
  input  wire        pll_clk, clk, rst, en_vtc,
  input  wire [55:0] txd,
  output wire [6:0]  txo,
  output wire        rdy);
  wire [279:0] rx_c2s, rx_s2c, tx_c2s, tx_s2c;
  wire dly_rdy, vtc_rdy;
  assign rdy = dly_rdy & vtc_rdy;
  BITSLICE_CONTROL #(.CTRL_CLK("EXTERNAL"), .DIV_MODE("DIV4"), .EN_CLK_TO_EXT_NORTH("DISABLE"), .EN_CLK_TO_EXT_SOUTH("DISABLE"),
     .EN_DYN_ODLY_MODE("FALSE"), .EN_OTHER_NCLK("FALSE"), .EN_OTHER_PCLK("FALSE"), .IDLY_VT_TRACK("TRUE"), .INV_RXCLK("FALSE"),
     .ODLY_VT_TRACK("TRUE"), .QDLY_VT_TRACK("TRUE"), .READ_IDLE_COUNT(6'h00), .REFCLK_SRC("PLLCLK"), .ROUNDING_FACTOR(16),
     .RXGATE_EXTEND("FALSE"), .RX_CLK_PHASE_N("SHIFT_0"), .RX_CLK_PHASE_P("SHIFT_0"), .RX_GATING("DISABLE"),
     .SELF_CALIBRATE("ENABLE"), .SERIAL_MODE("FALSE"), .SIM_DEVICE("ULTRASCALE_PLUS"), .TX_GATING("DISABLE")) u_bsc (
     .PLL_CLK(pll_clk), .REFCLK(1'b0), .RST(rst), .EN_VTC(en_vtc), .DLY_RDY(dly_rdy), .VTC_RDY(vtc_rdy),
     .RIU_CLK(clk), .RIU_ADDR(6'd0), .RIU_NIBBLE_SEL(1'b0), .RIU_WR_DATA(16'd0), .RIU_WR_EN(1'b0), .RIU_RD_DATA(), .RIU_VALID(),
     .CLK_FROM_EXT(1'b1), .CLK_TO_EXT_NORTH(), .CLK_TO_EXT_SOUTH(), .DYN_DCI(),
     .NCLK_NIBBLE_IN(1'b1), .PCLK_NIBBLE_IN(1'b1), .NCLK_NIBBLE_OUT(), .PCLK_NIBBLE_OUT(),
     .PHY_RDCS0(4'd0), .PHY_RDCS1(4'd0), .PHY_RDEN(4'hF), .PHY_WRCS0(4'd0), .PHY_WRCS1(4'd0), .TBYTE_IN(4'hF),
     .RX_BIT_CTRL_IN0(rx_s2c[0+:40]), .RX_BIT_CTRL_IN1(rx_s2c[40+:40]), .RX_BIT_CTRL_IN2(rx_s2c[80+:40]), .RX_BIT_CTRL_IN3(rx_s2c[120+:40]),
     .RX_BIT_CTRL_IN4(rx_s2c[160+:40]), .RX_BIT_CTRL_IN5(rx_s2c[200+:40]), .RX_BIT_CTRL_IN6(rx_s2c[240+:40]),
     .RX_BIT_CTRL_OUT0(rx_c2s[0+:40]), .RX_BIT_CTRL_OUT1(rx_c2s[40+:40]), .RX_BIT_CTRL_OUT2(rx_c2s[80+:40]), .RX_BIT_CTRL_OUT3(rx_c2s[120+:40]),
     .RX_BIT_CTRL_OUT4(rx_c2s[160+:40]), .RX_BIT_CTRL_OUT5(rx_c2s[200+:40]), .RX_BIT_CTRL_OUT6(rx_c2s[240+:40]),
     .TX_BIT_CTRL_IN0(tx_s2c[0+:40]), .TX_BIT_CTRL_IN1(tx_s2c[40+:40]), .TX_BIT_CTRL_IN2(tx_s2c[80+:40]), .TX_BIT_CTRL_IN3(tx_s2c[120+:40]),
     .TX_BIT_CTRL_IN4(tx_s2c[160+:40]), .TX_BIT_CTRL_IN5(tx_s2c[200+:40]), .TX_BIT_CTRL_IN6(tx_s2c[240+:40]),
     .TX_BIT_CTRL_OUT0(tx_c2s[0+:40]), .TX_BIT_CTRL_OUT1(tx_c2s[40+:40]), .TX_BIT_CTRL_OUT2(tx_c2s[80+:40]), .TX_BIT_CTRL_OUT3(tx_c2s[120+:40]),
     .TX_BIT_CTRL_OUT4(tx_c2s[160+:40]), .TX_BIT_CTRL_OUT5(tx_c2s[200+:40]), .TX_BIT_CTRL_OUT6(tx_c2s[240+:40]),
     .TX_BIT_CTRL_IN_TRI(40'd0), .TX_BIT_CTRL_OUT_TRI());
  genvar b;
  generate for (b = 0; b < 7; b = b + 1) begin : g_b
    if (TXMASK[b]) begin : g_tx
      TX_BITSLICE #(.DATA_WIDTH(8), .DELAY_FORMAT("TIME"), .DELAY_TYPE("FIXED"), .DELAY_VALUE(0), .ENABLE_PRE_EMPHASIS("FALSE"),
         .INIT(1'b0), .NATIVE_ODELAY_BYPASS("FALSE"), .OUTPUT_PHASE_90("FALSE"), .REFCLK_FREQUENCY(1600.0),
         .SIM_DEVICE("ULTRASCALE_PLUS"), .TBYTE_CTL("T"), .UPDATE_MODE("ASYNC")) u_tx (
         .CE(1'b0), .CLK(clk), .CNTVALUEIN(9'd0), .CNTVALUEOUT(), .D(txd[8*b+:8]), .EN_VTC(en_vtc), .INC(1'b0), .LOAD(1'b0),
         .O(txo[b]), .RST(rst), .RST_DLY(rst), .T(1'b0), .T_OUT(), .TBYTE_IN(1'b0),
         .RX_BIT_CTRL_IN(rx_c2s[40*b+:40]), .RX_BIT_CTRL_OUT(rx_s2c[40*b+:40]),
         .TX_BIT_CTRL_IN(tx_c2s[40*b+:40]), .TX_BIT_CTRL_OUT(tx_s2c[40*b+:40]));
    end else begin : g_none
      assign rx_s2c[40*b+:40] = 40'd0;
      assign tx_s2c[40*b+:40] = 40'd0;
      assign txo[b] = 1'b0;
    end
  end endgenerate
endmodule

module lpddr5_pincheck_top #(
  parameter integer RX_SLVS        = 0,   // 0: IBUFDS_DPHY / MIPI_DPHY_DCI, 1: IBUFDS / SLVS_400_18, 2 / 3: IBUFDS_DPHY, attribute DEFAULT
  parameter integer CMD_NATIVE     = 1,   // 1: native TX_BITSLICE at 1.6 Gb/s, 0: OSERDESE3
  parameter integer RDQS_AS_CLOCK  = 0,   // 0: RDQS sampled like data; 1 / 2: RDQS through a BUFGCE clocks the capture flops
  parameter integer GUARD_BITSLICE = 1,   // native mode: 1 = the open finger is a TX_BITSLICE at constant 0, 0 = a plain OBUF
  parameter integer CMD_COMP_800   = 0,   // component mode: 0 = 600 MHz bit clock (1.2 Gb/s), 1 = 800 MHz (1.6 Gb/s)
  // Vivado 2026.1 wants "ULTRASCALE_PLUS" here and refuses the bitstream otherwise (DRC ADEF-911); Vivado 2023.1 knows
  // only "7SERIES" / "ULTRASCALE" and refuses the bitstream for "ULTRASCALE_PLUS" (the same DRC)
  parameter         IDELAYCTRL_SIM_DEVICE = "ULTRASCALE_PLUS"
)(
  input  wire       clk300_p, clk300_n,
  output wire [6:0] ca,
  output wire       cs0,
  output wire       ck_p, ck_n,
  output wire       cmd_open_low,
  output wire [7:0] wdq,
  output wire       wck_p, wck_n,
  input  wire [7:0] rdq_p, rdq_n,
  input  wire       rdqs_p, rdqs_n,
  output wire       reset_n,
  output wire       led
);
`include "lpddr5_testbed_pins.vh"

  // ------------------------------------------------------------------ clocks
  wire clk300_i, mm_fb, mm_hs, mm_200, mm_cmp, mm_locked;
  wire clk_hs, clk_div, clk200;
  IBUFDS u_ibclk (.I(clk300_p), .IB(clk300_n), .O(clk300_i));
  // VCO 1200 MHz: 400 MHz bit clock of the component-mode serdes (800 Mb/s), 200 MHz for the command PLL,
  // 600 MHz for the component-mode command variant
  MMCME4_BASE #(.CLKIN1_PERIOD(3.333), .CLKFBOUT_MULT_F(4.0), .DIVCLK_DIVIDE(1), .CLKOUT0_DIVIDE_F(3.0), .CLKOUT1_DIVIDE(6),
                .CLKOUT2_DIVIDE(2)) u_mmcm
    (.CLKIN1(clk300_i), .CLKFBIN(mm_fb), .CLKFBOUT(mm_fb), .CLKOUT0(mm_hs), .CLKOUT1(mm_200), .CLKOUT2(mm_cmp),
     .LOCKED(mm_locked), .PWRDWN(1'b0), .RST(1'b0));
  BUFGCE     u_bhs  (.I(mm_hs), .CE(1'b1), .O(clk_hs));                                        // 400 MHz
  BUFGCE_DIV #(.BUFGCE_DIVIDE(4)) u_bdiv (.I(mm_hs), .CE(1'b1), .CLR(1'b0), .O(clk_div));     // 100 MHz
  BUFGCE     u_b200 (.I(mm_200), .CE(1'b1), .O(clk200));                                       // 200 MHz

  reg [7:0] rst_sr = 8'hFF;
  always @(posedge clk_div) rst_sr <= {rst_sr[6:0], ~mm_locked};
  wire rst = rst_sr[7];
  reg [31:0] lfsr = 32'hACE1_2345;
  always @(posedge clk_div) lfsr <= {lfsr[30:0], lfsr[31] ^ lfsr[21] ^ lfsr[1] ^ lfsr[0]};

  wire idc_rdy;
  // EN_VTC of the delay lines is logic-driven: it has to go low while a new value is loaded (training)
  reg dly_en_vtc = 1'b1, dly_load = 1'b0;
  always @(posedge clk_div) begin dly_en_vtc <= ~lfsr[30]; dly_load <= lfsr[30] & lfsr[29] & ~dly_en_vtc; end
  (* IODELAY_GROUP = "pincheck" *)
  IDELAYCTRL #(.SIM_DEVICE(IDELAYCTRL_SIM_DEVICE)) u_idc (.REFCLK(clk_hs), .RST(rst), .RDY(idc_rdy));

  // ------------------------------------------------------------------ command bus (bank 65)
  wire cmd_par;
  generate
    if (CMD_NATIVE != 0) begin : g_cmd_native
      // PLL in the command bank: 200 MHz x4 = 800 MHz VCO, CLKOUTPHY = VCO x2 = 1600 MHz -> 1.6 Gb/s, CK = 800 MHz
      wire pll_fb, pll_phy, pll_c0, pll_locked, clk_cmd;
      PLLE4_ADV #(.CLKIN_PERIOD(5.0), .CLKFBOUT_MULT(4), .DIVCLK_DIVIDE(1), .CLKOUT0_DIVIDE(4), .CLKOUTPHY_MODE("VCO_2X")) u_pll (
         .CLKIN(clk200), .CLKFBIN(pll_fb), .CLKFBOUT(pll_fb), .CLKOUT0(pll_c0), .CLKOUT0B(), .CLKOUT1(), .CLKOUT1B(),
         .CLKOUTPHY(pll_phy), .CLKOUTPHYEN(1'b1), .LOCKED(pll_locked), .PWRDWN(1'b0), .RST(1'b0),
         .DADDR(7'd0), .DCLK(1'b0), .DEN(1'b0), .DI(16'd0), .DWE(1'b0), .DO(), .DRDY());
      BUFG u_bcmd (.I(pll_c0), .O(clk_cmd));                                                   // 200 MHz = 1.6 Gb/s / 8
      reg [7:0] crst = 8'hFF;
      always @(posedge clk_cmd) crst <= {crst[6:0], ~pll_locked};
      wire [1:0] rdy;
      reg en_vtc = 1'b0;
      always @(posedge clk_cmd) en_vtc <= &rdy;
      reg [31:0] cl = 32'h1357_9BDF;
      always @(posedge clk_cmd) cl <= {cl[30:0], cl[31] ^ cl[21] ^ cl[1] ^ cl[0]};
      reg [55:0] d_l, d_u;
      wire [6:0] o_l, o_u;
      always @(posedge clk_cmd) begin
        d_u[16 +: 8] <= cl[4 +: 8];   // ca[0]: DDR, 1.6 Gb/s
        d_u[24 +: 8] <= cl[5 +: 8];   // ca[1]: DDR, 1.6 Gb/s
        d_l[24 +: 8] <= cl[6 +: 8];   // ca[2]: DDR, 1.6 Gb/s
        d_u[40 +: 8] <= cl[7 +: 8];   // ca[3]: DDR, 1.6 Gb/s
        d_u[32 +: 8] <= cl[8 +: 8];   // ca[4]: DDR, 1.6 Gb/s
        d_l[40 +: 8] <= cl[9 +: 8];   // ca[5]: DDR, 1.6 Gb/s
        d_l[32 +: 8] <= cl[10 +: 8];   // ca[6]: DDR, 1.6 Gb/s
        d_u[0 +: 8] <= (CK_INVERTED != 0) ? 8'b10101010 : 8'b01010101;   // CK: 800 MHz
        d_l[16 +: 8] <= {{2{cl[3]}}, {2{cl[2]}}, {2{cl[1]}}, {2{cl[0]}}};   // CS: SDR
        d_l[0 +: 8] <= 8'h00;   // the open finger 75: constant low
        d_l[8 +: 8] <= 8'h00;
        d_u[8 +: 8] <= 8'h00;
        d_l[48 +: 8] <= 8'h00;
        d_u[48 +: 8] <= 8'h00;
      end
      pincheck_cmd_nibble #(.TXMASK(GUARD_BITSLICE != 0 ? 7'b0111101 : 7'b0111100)) u_nib_l
        (.pll_clk(pll_phy), .clk(clk_cmd), .rst(crst[7]), .en_vtc(en_vtc), .txd(d_l), .txo(o_l), .rdy(rdy[0]));
      pincheck_cmd_nibble #(.TXMASK(7'b0111101)) u_nib_u
        (.pll_clk(pll_phy), .clk(clk_cmd), .rst(crst[7]), .en_vtc(en_vtc), .txd(d_u), .txo(o_u), .rdy(rdy[1]));
      OBUF   u_ob_ca0 (.I(o_u[2]), .O(ca[0]));   // AN22, T0U bitslice 2
      OBUF   u_ob_ca1 (.I(o_u[3]), .O(ca[1]));   // AP23, T0U bitslice 3
      OBUF   u_ob_ca2 (.I(o_l[3]), .O(ca[2]));   // AN19, T0L bitslice 3
      OBUF   u_ob_ca3 (.I(o_u[5]), .O(ca[3]));   // AN23, T0U bitslice 5
      OBUF   u_ob_ca4 (.I(o_u[4]), .O(ca[4]));   // AM23, T0U bitslice 4
      OBUF   u_ob_ca5 (.I(o_l[5]), .O(ca[5]));   // AP22, T0L bitslice 5
      OBUF   u_ob_ca6 (.I(o_l[4]), .O(ca[6]));   // AP21, T0L bitslice 4
      OBUFDS u_ob_ck (.I(o_u[0]), .O(ck_p), .OB(ck_n));   // AM21 / AN21, T0U bitslice 0
      OBUF   u_ob_cs (.I(o_l[2]), .O(cs0));   // AM19, T0L bitslice 2
      if (GUARD_BITSLICE != 0) begin : g_guard_bs
        OBUF u_ob_guard (.I(o_l[0]), .O(cmd_open_low));   // AP19, T0L bitslice 0
      end else begin : g_guard_obuf
        OBUF u_ob_guard (.I(1'b0), .O(cmd_open_low));
      end
      reg par = 1'b0;
      always @(posedge clk_cmd) par <= par ^ cl[0] ^ (&rdy);
      assign cmd_par = par;
    end else begin : g_cmd_comp
      wire cclk_hs, cclk_div;
      if (CMD_COMP_800 != 0) begin : g_800
        wire pll_fb, pll_c0, pll_locked;
        PLLE4_ADV #(.CLKIN_PERIOD(5.0), .CLKFBOUT_MULT(4), .DIVCLK_DIVIDE(1), .CLKOUT0_DIVIDE(1), .CLKOUTPHY_MODE("VCO")) u_pll (
           .CLKIN(clk200), .CLKFBIN(pll_fb), .CLKFBOUT(pll_fb), .CLKOUT0(pll_c0), .CLKOUT0B(), .CLKOUT1(), .CLKOUT1B(),
           .CLKOUTPHY(), .CLKOUTPHYEN(1'b0), .LOCKED(pll_locked), .PWRDWN(1'b0), .RST(1'b0),
           .DADDR(7'd0), .DCLK(1'b0), .DEN(1'b0), .DI(16'd0), .DWE(1'b0), .DO(), .DRDY());
        BUFGCE     u_bc  (.I(pll_c0), .CE(1'b1), .O(cclk_hs));                                  // 800 MHz
        BUFGCE_DIV #(.BUFGCE_DIVIDE(4)) u_bcd (.I(pll_c0), .CE(1'b1), .CLR(1'b0), .O(cclk_div));
      end else begin : g_600
        BUFGCE     u_bc  (.I(mm_cmp), .CE(1'b1), .O(cclk_hs));                                  // 600 MHz
        BUFGCE_DIV #(.BUFGCE_DIVIDE(4)) u_bcd (.I(mm_cmp), .CE(1'b1), .CLR(1'b0), .O(cclk_div));
      end
      reg [7:0] crst = 8'hFF;
      always @(posedge cclk_div) crst <= {crst[6:0], ~mm_locked};
      reg [31:0] cl = 32'h1357_9BDF;
      always @(posedge cclk_div) cl <= {cl[30:0], cl[31] ^ cl[21] ^ cl[1] ^ cl[0]};
      wire [8:0] oq;                       // 0-6 CA, 7 CS, 8 CK
      genvar k;
      for (k = 0; k < 9; k = k + 1) begin : g_os
        reg [7:0] d;
        always @(posedge cclk_div) d <= (k == 8) ? (CK_INVERTED != 0 ? 8'b10101010 : 8'b01010101) : cl[k +: 8];
        OSERDESE3 #(.DATA_WIDTH(8), .SIM_DEVICE("ULTRASCALE_PLUS")) u_os
          (.CLK(cclk_hs), .CLKDIV(cclk_div), .D(d), .RST(crst[7]), .OQ(oq[k]), .T(1'b0), .T_OUT());
      end
      for (k = 0; k < 7; k = k + 1) begin : g_ob
        OBUF u_ob (.I(oq[k]), .O(ca[k]));
      end
      OBUF   u_ob_cs (.I(oq[7]), .O(cs0));
      OBUFDS u_ob_ck (.I(oq[8]), .O(ck_p), .OB(ck_n));
      OBUF u_ob_guard (.I(1'b0), .O(cmd_open_low));
      reg par = 1'b0;
      always @(posedge cclk_div) par <= par ^ cl[0];
      assign cmd_par = par;
    end
  endgenerate

  // ------------------------------------------------------------------ write side (bank 64)
  reg wr_en = 1'b0;                        // write DQ pins are Hi-Z during reads
  always @(posedge clk_div) wr_en <= lfsr[31];
  genvar i;
  generate
    for (i = 0; i < 8; i = i + 1) begin : g_wdq
      localparam integer DV = WDQ_ODELAY_PS[16*i +: 16];
      reg [7:0] d;
      always @(posedge clk_div) d <= lfsr[i +: 8];
      wire oq, tq, od;
      OSERDESE3 #(.DATA_WIDTH(8), .SIM_DEVICE("ULTRASCALE_PLUS")) u_os
        (.CLK(clk_hs), .CLKDIV(clk_div), .D(d), .RST(rst), .OQ(oq), .T(~wr_en), .T_OUT(tq));
      (* IODELAY_GROUP = "pincheck" *)
      ODELAYE3 #(.CASCADE("NONE"), .DELAY_FORMAT("TIME"), .DELAY_TYPE("VAR_LOAD"), .DELAY_VALUE(DV), .REFCLK_FREQUENCY(400.0),
                 .SIM_DEVICE("ULTRASCALE_PLUS"), .UPDATE_MODE("ASYNC")) u_od
        (.CASC_IN(1'b0), .CASC_RETURN(1'b0), .CASC_OUT(), .CE(1'b0), .CLK(clk_div), .CNTVALUEIN(lfsr[8:0]), .CNTVALUEOUT(),
         .ODATAIN(oq), .DATAOUT(od), .EN_VTC(dly_en_vtc), .INC(1'b0), .LOAD(dly_load), .RST(rst));
      OBUFT u_ob (.I(od), .T(tq), .O(wdq[i]));
    end
  endgenerate
  // WCK: the pattern is inverted when the true leg of the card sits on the FPGA N pin
  reg [7:0] wck_d;
  always @(posedge clk_div) wck_d <= (WCK_INVERTED != 0) ? 8'b10101010 : 8'b01010101;
  wire wck_oq, wck_od;
  OSERDESE3 #(.DATA_WIDTH(8), .SIM_DEVICE("ULTRASCALE_PLUS")) u_os_wck
    (.CLK(clk_hs), .CLKDIV(clk_div), .D(wck_d), .RST(rst), .OQ(wck_oq), .T(1'b0), .T_OUT());
  (* IODELAY_GROUP = "pincheck" *)
  ODELAYE3 #(.CASCADE("NONE"), .DELAY_FORMAT("TIME"), .DELAY_TYPE("VAR_LOAD"), .DELAY_VALUE(0), .REFCLK_FREQUENCY(400.0),
             .SIM_DEVICE("ULTRASCALE_PLUS"), .UPDATE_MODE("ASYNC")) u_od_wck
    (.CASC_IN(1'b0), .CASC_RETURN(1'b0), .CASC_OUT(), .CE(1'b0), .CLK(clk_div), .CNTVALUEIN(lfsr[8:0]), .CNTVALUEOUT(),
     .ODATAIN(wck_oq), .DATAOUT(wck_od), .EN_VTC(dly_en_vtc), .INC(1'b0), .LOAD(dly_load), .RST(rst));
  OBUFDS u_ob_wck (.I(wck_od), .O(wck_p), .OB(wck_n));

  // ------------------------------------------------------------------ read side (bank 66)
  wire [8:0] rx;                            // 0-7 DQ, 8 RDQS
  wire [8:0] rx_pp = {rdqs_p, rdq_p};
  wire [8:0] rx_nn = {rdqs_n, rdq_n};
  generate
    for (i = 0; i < 9; i = i + 1) begin : g_rx
      if (RX_SLVS == 0) begin : g_dphy
        IBUFDS_DPHY #(.DIFF_TERM("FALSE"), .IOSTANDARD("MIPI_DPHY_DCI"), .SIM_DEVICE("ULTRASCALE_PLUS")) u_ib
          (.I(rx_pp[i]), .IB(rx_nn[i]), .HSRX_DISABLE(1'b0), .LPRX_DISABLE(1'b1),
           .HSRX_O(rx[i]), .LPRX_O_N(), .LPRX_O_P());
      end else if (RX_SLVS == 2 || RX_SLVS == 3) begin : g_dphy_default
        IBUFDS_DPHY #(.DIFF_TERM("FALSE"), .IOSTANDARD("DEFAULT"), .SIM_DEVICE("ULTRASCALE_PLUS")) u_ib
          (.I(rx_pp[i]), .IB(rx_nn[i]), .HSRX_DISABLE(1'b0), .LPRX_DISABLE(1'b1),
           .HSRX_O(rx[i]), .LPRX_O_N(), .LPRX_O_P());
      end else begin : g_slvs
        IBUFDS u_ib (.I(rx_pp[i]), .IB(rx_nn[i]), .O(rx[i]));
      end
    end
  endgenerate
  wire [8:0] rx_dly;
  generate
    for (i = 0; i < 9; i = i + 1) begin : g_idly
      localparam integer DV = (i == 8) ? RDQS_IDELAY_PS : RDQ_IDELAY_PS[16*(i % 8) +: 16];
      (* IODELAY_GROUP = "pincheck" *)
      IDELAYE3 #(.CASCADE("NONE"), .DELAY_FORMAT("TIME"), .DELAY_SRC("IDATAIN"), .DELAY_TYPE("VAR_LOAD"), .DELAY_VALUE(DV),
                 .REFCLK_FREQUENCY(400.0), .SIM_DEVICE("ULTRASCALE_PLUS"), .UPDATE_MODE("ASYNC")) u_id
        (.CASC_IN(1'b0), .CASC_RETURN(1'b0), .CASC_OUT(), .CE(1'b0), .CLK(clk_div), .CNTVALUEIN(lfsr[8:0]), .CNTVALUEOUT(),
         .DATAIN(1'b0), .IDATAIN(rx[i]), .DATAOUT(rx_dly[i]), .EN_VTC(dly_en_vtc), .INC(1'b0), .LOAD(dly_load), .RST(rst));
    end
  endgenerate
  reg [8:0] rd_par = 9'd0;
  generate
    if (RDQS_AS_CLOCK == 0) begin : g_rd_serdes
      // 8x oversampling of a 100 Mb/s read with the system clock; the strobe is sampled like data and inverted here
      for (i = 0; i < 9; i = i + 1) begin : g_b
        wire [7:0] q;
        ISERDESE3 #(.DATA_WIDTH(8), .FIFO_ENABLE("FALSE"), .FIFO_SYNC_MODE("FALSE"), .IS_CLK_B_INVERTED(1'b1),
                    .SIM_DEVICE("ULTRASCALE_PLUS")) u_is
          (.CLK(clk_hs), .CLK_B(clk_hs), .CLKDIV(clk_div), .D(rx_dly[i]), .Q(q), .RST(rst),
           .FIFO_RD_CLK(1'b0), .FIFO_RD_EN(1'b0), .FIFO_EMPTY(), .INTERNAL_DIVCLK());
        reg [7:0] qr;
        always @(posedge clk_div) begin
          qr <= (i == 8 && RDQS_INVERTED != 0) ? ~q : q;
          rd_par[i] <= ^qr;
        end
      end
    end else begin : g_rd_strobe
      // the strobe as a clock: RDQS receiver (-> IDELAYE3 if RDQS_AS_CLOCK = 1) -> BUFGCE -> capture flops (both edges)
      // the inverted pair is handled by swapping the two capture edges: nothing stands between receiver and buffer
      wire rdqs_src = (RDQS_AS_CLOCK == 1) ? rx_dly[8] : rx[8];
      wire rdqs_clk;
      BUFGCE u_brdqs (.I(rdqs_src), .CE(1'b1), .O(rdqs_clk));
      reg [7:0] cr, cf;
      always @(posedge rdqs_clk) cr <= rx_dly[7:0];
      always @(negedge rdqs_clk) cf <= rx_dly[7:0];
      (* ASYNC_REG = "TRUE" *) reg [15:0] s0, s1;
      always @(posedge clk_div) begin
        s0 <= (RDQS_INVERTED != 0) ? {cr, cf} : {cf, cr};
        s1 <= s0;
        rd_par <= {1'b0, s1[15:8] ^ s1[7:0]};
      end
    end
  endgenerate

  // ------------------------------------------------------------------ RESET_n and the observation pin
  reg rst_n_q = 1'b0;
  always @(posedge clk_div) rst_n_q <= ~rst & idc_rdy;
  OBUF u_ob_rst (.I(rst_n_q), .O(reset_n));
  (* ASYNC_REG = "TRUE" *) reg xdom_sync0 = 1'b0, xdom_sync1 = 1'b0;
  reg led_q = 1'b0;
  always @(posedge clk_div) begin xdom_sync0 <= cmd_par; xdom_sync1 <= xdom_sync0; led_q <= ^rd_par ^ xdom_sync1; end
  OBUF u_ob_led (.I(led_q), .O(led));
endmodule
